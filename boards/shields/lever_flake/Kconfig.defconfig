## boards/shields/lever_flake/Kconfig.defconfig
```kconfig
if SHIELD_LEVER_FLAKE_LEFT

config ZMK_KEYBOARD_NAME
    default "Lever Flake"

config ZMK_SPLIT_ROLE_CENTRAL
    default y

config ZMK_STUDIO
    default y

endif

if SHIELD_LEVER_FLAKE_LEFT || SHIELD_LEVER_FLAKE_RIGHT

config ZMK_SPLIT
    default y

endif
```

## boards/shields/lever_flake/Kconfig.shield
```kconfig
config SHIELD_LEVER_FLAKE_LEFT
    def_bool $(shields_list_contains,lever_flake_left)

config SHIELD_LEVER_FLAKE_RIGHT
    def_bool $(shields_list_contains,lever_flake_right)
```
