#include "lever_flake.dtsi"

&large_transform {
    col-offset = <6>;
};

&medium_transform {
    col-offset = <6>;
};

&small_transform {
    col-offset = <6>;
};

&kscan0 {
    col-gpios
    = <&xiao_d 5 GPIO_ACTIVE_HIGH>
    , <&xiao_d 4 GPIO_ACTIVE_HIGH>
    , <&xiao_d 3 GPIO_ACTIVE_HIGH>
    , <&xiao_d 2 GPIO_ACTIVE_HIGH>
    , <&xiao_d 1 GPIO_ACTIVE_HIGH>
    , <&xiao_d 0 GPIO_ACTIVE_HIGH>
    ;
};
